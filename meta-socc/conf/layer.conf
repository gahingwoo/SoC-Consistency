## meta-socc/conf/layer.conf
```bitbake
# meta-socc — SoC-Consistency Yocto Layer
#
# This layer integrates socc hardware-constraint validation as a mandatory
# pre-build gate in the Yocto/OpenEmbedded build pipeline.
#
# It intercepts the build at do_configure time (before the multi-hour
# compilation marathon begins) and aborts the build immediately if the
# DTS file contains physical violations.
#
# SPDX-License-Identifier: MIT

SUMMARY     = "meta-socc: SoC-Consistency hardware constraint gate for Yocto"
DESCRIPTION = "Runs `socc check` on the board DTS before do_configure. \
               Aborts the build with a human-readable error when physical \
               hardware constraints are violated, saving hours of wasted \
               build time and preventing hardware damage on first boot."
HOMEPAGE    = "https://github.com/woo/SoC-Consistency"
LICENSE     = "MIT"

LAYERVERSION = "1"
LAYERDEPENDS = "core"

LAYERSERIES_COMPAT = "scarthgap nanbield mickledore"
```
